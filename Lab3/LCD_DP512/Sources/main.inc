
; ANSI-C/cC++ Compiler for HC12 V-5.0.35 Build 8093, Apr  3 2008
;
; Automatic generated include file for the assembler
; Generated using the following files :
; file :'D:\EE345L\9S12DP512\LCD_DP512\Sources\main.c'
; file :'C:\Program Files\Freescale\CodeWarrior for HCS12 V4.7\lib\HC12c\include\hidef.h'
; file :'C:\Program Files\Freescale\CodeWarrior for HCS12 V4.7\lib\HC12c\include\default.sgm'
; file :'C:\Program Files\Freescale\CodeWarrior for HCS12 V4.7\lib\HC12c\include\stdtypes.h'
; file :'C:\Program Files\Freescale\CodeWarrior for HCS12 V4.7\lib\HC12c\include\stddef.h'
; file :'C:\Program Files\Freescale\CodeWarrior for HCS12 V4.7\lib\HC12c\include\mc9s12dp512.h'
; file :'D:\EE345L\9S12DP512\LCD_DP512\Sources\LCD.H'
; file :'D:\EE345L\9S12DP512\LCD_DP512\Sources\PLL.H'
;
